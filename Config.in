## Config.in
```kconfig
source "$BR2_EXTERNAL_FT_TXT_PATH/package/wt/Config.in"
source "$BR2_EXTERNAL_FT_TXT_PATH/package/python-ufw/Config.in"
source "$BR2_EXTERNAL_FT_TXT_PATH/package/libulfius/Config.in"
source "$BR2_EXTERNAL_FT_TXT_PATH/package/libyder/Config.in"
source "$BR2_EXTERNAL_FT_TXT_PATH/package/liborcania/Config.in"
source "$BR2_EXTERNAL_FT_TXT_PATH/package/libnfc-git/Config.in"
source "$BR2_EXTERNAL_FT_TXT_PATH/package/libfreefare-git/Config.in"
source "$BR2_EXTERNAL_FT_TXT_PATH/package/civetweb-git/Config.in"
source "$BR2_EXTERNAL_FT_TXT_PATH/package/python-mod_wsgi/Config.in"
source "$BR2_EXTERNAL_FT_TXT_PATH/package/python-ftrobopy/Config.in"
source "$BR2_EXTERNAL_FT_TXT_PATH/package/python-speedtest-cli/Config.in"
```

## configs/FT-TXT_4.1_defconfig
```kconfig
BR2_arm=y
BR2_cortex_a8=y
BR2_ARM_FPU_NEON=y
BR2_ARM_INSTRUCTIONS_THUMB2=y
BR2_DL_DIR="~/buildroot_dl"
BR2_HOST_DIR="/opt/FT/TXT"
# BR2_COMPILER_PARANOID_UNSAFE_PATH is not set
BR2_TOOLCHAIN_EXTERNAL=y
BR2_TOOLCHAIN_EXTERNAL_LINARO_ARM=y
BR2_PACKAGE_HOST_GDB=y
BR2_PACKAGE_HOST_GDB_TUI=y
BR2_PACKAGE_HOST_GDB_PYTHON=y
BR2_TARGET_OPTIMIZATION="-pipe"
BR2_TARGET_GENERIC_HOSTNAME="FT-Txt"
BR2_TARGET_GENERIC_ISSUE="Welcome to FT-TXT"
BR2_TARGET_GENERIC_PASSWD_SHA512=y
BR2_ROOTFS_DEVICE_CREATION_DYNAMIC_EUDEV=y
BR2_ROOTFS_DEVICE_TABLE="system/device_table.txt ../FT-TXT/board/FT/TXT/device_table.txt"
BR2_TARGET_GENERIC_ROOT_PASSWD="root"
BR2_TARGET_GENERIC_GETTY_PORT="ttyO0"
BR2_TARGET_GENERIC_GETTY_BAUDRATE_115200=y
BR2_TARGET_TZ_INFO=y
BR2_TARGET_LOCALTIME="Europe/Berlin"
BR2_ROOTFS_USERS_TABLES="../FT-TXT/board/FT/TXT/user.tab"
BR2_ROOTFS_POST_BUILD_SCRIPT="../FT-TXT/board/FT/TXT/post-build_4.1.sh"
BR2_LINUX_KERNEL=y
BR2_LINUX_KERNEL_CUSTOM_GIT=y
BR2_LINUX_KERNEL_CUSTOM_REPO_URL="git://git.ti.com/ti-linux-kernel/ti-linux-kernel.git"
BR2_LINUX_KERNEL_CUSTOM_REPO_VERSION="ti-linux-4.1.y"
BR2_LINUX_KERNEL_PATCH="../FT-TXT/board/FT/TXT/linux_4.1.y"
BR2_LINUX_KERNEL_USE_CUSTOM_CONFIG=y
BR2_LINUX_KERNEL_CUSTOM_CONFIG_FILE="../FT-TXT/board/FT/TXT/TXT_defconfig"
BR2_LINUX_KERNEL_UIMAGE=y
BR2_LINUX_KERNEL_UIMAGE_LOADADDR="0x80008000"
BR2_LINUX_KERNEL_DTS_SUPPORT=y
BR2_LINUX_KERNEL_CUSTOM_DTS_PATH="../FT-TXT/board/FT/TXT/DTS_4.1/am335x-kno_txt.dts"
BR2_PACKAGE_BUSYBOX_CONFIG="../FT-TXT/board/FT/TXT/busybox.config"
BR2_PACKAGE_BUSYBOX_SHOW_OTHERS=y
BR2_PACKAGE_STRACE=y
BR2_PACKAGE_FLEX=y
BR2_PACKAGE_FLASHBENCH=y
BR2_PACKAGE_MMC_UTILS=y
BR2_PACKAGE_MTD=y
BR2_PACKAGE_MTD_MKFSUBIFS=y
BR2_PACKAGE_MTD_MTDPART=y
BR2_PACKAGE_LIBERATION=y
BR2_PACKAGE_DIRECTFB=y
BR2_PACKAGE_FB_TEST_APP=y
BR2_PACKAGE_FBGRAB=y
BR2_PACKAGE_FBSET=y
BR2_PACKAGE_FBV=y
BR2_PACKAGE_LINUX_FUSION=y
BR2_PACKAGE_PSPLASH=y
BR2_PACKAGE_SDL=y
BR2_PACKAGE_SDL_GFX=y
BR2_PACKAGE_SDL_IMAGE=y
BR2_PACKAGE_SDL_IMAGE_GIF=y
BR2_PACKAGE_SDL_IMAGE_JPEG=y
BR2_PACKAGE_SDL_IMAGE_LBM=y
BR2_PACKAGE_SDL_IMAGE_PCX=y
BR2_PACKAGE_SDL_IMAGE_PNG=y
BR2_PACKAGE_SDL_IMAGE_PNM=y
BR2_PACKAGE_SDL_IMAGE_TARGA=y
BR2_PACKAGE_SDL_IMAGE_TIFF=y
BR2_PACKAGE_SDL_IMAGE_WEBP=y
BR2_PACKAGE_SDL_IMAGE_XCF=y
BR2_PACKAGE_SDL_IMAGE_XPM=y
BR2_PACKAGE_SDL_IMAGE_XV=y
BR2_PACKAGE_SDL_NET=y
BR2_PACKAGE_SDL_TTF=y
BR2_PACKAGE_AM33X_CM3=y
BR2_PACKAGE_LINUX_FIRMWARE=y
BR2_PACKAGE_LINUX_FIRMWARE_RTL_81XX=y
BR2_PACKAGE_LINUX_FIRMWARE_RTL_87XX=y
BR2_PACKAGE_LINUX_FIRMWARE_TI_WL127X=y
BR2_PACKAGE_LINUX_FIRMWARE_TI_WL128X=y
BR2_PACKAGE_LINUX_FIRMWARE_TI_WL18XX=y
BR2_PACKAGE_WILINK_BT_FIRMWARE=y
BR2_PACKAGE_DBUS_PYTHON=y
BR2_PACKAGE_DBUS_TRIGGERD=y
BR2_PACKAGE_EVEMU=y
BR2_PACKAGE_EVTEST=y
BR2_PACKAGE_HWDATA=y
BR2_PACKAGE_I2C_TOOLS=y
BR2_PACKAGE_KBD=y
BR2_PACKAGE_LIBUIO=y
BR2_PACKAGE_LINUXCONSOLETOOLS=y
BR2_PACKAGE_LSUIO=y
BR2_PACKAGE_RNG_TOOLS=y
BR2_PACKAGE_RS485CONF=y
BR2_PACKAGE_SPI_TOOLS=y
BR2_PACKAGE_TI_UIM=y
BR2_PACKAGE_TI_UTILS=y
BR2_PACKAGE_TRIGGERHAPPY=y
BR2_PACKAGE_USB_MODESWITCH_DATA=y
BR2_PACKAGE_USBMOUNT=y
BR2_PACKAGE_USBUTILS=y
BR2_PACKAGE_PYTHON3=y
BR2_PACKAGE_PYTHON3_BZIP2=y
BR2_PACKAGE_PYTHON3_CURSES=y
BR2_PACKAGE_PYTHON3_READLINE=y
BR2_PACKAGE_PYTHON3_SSL=y
BR2_PACKAGE_ALSA_LIB=y
BR2_PACKAGE_LIBID3TAG=y
BR2_PACKAGE_LIBMAD=y
BR2_PACKAGE_LIBSNDFILE=y
BR2_PACKAGE_LIBVORBIS=y
BR2_PACKAGE_OPUS=y
BR2_PACKAGE_SPEEX=y
BR2_PACKAGE_LIBZIP=y
BR2_PACKAGE_SZIP=y
BR2_PACKAGE_CA_CERTIFICATES=y
BR2_PACKAGE_LIBNSS=y
BR2_PACKAGE_LIBSHA1=y
BR2_PACKAGE_LIBSSH2=y
BR2_PACKAGE_NETTLE=y
BR2_PACKAGE_LIBOPENSSL_BIN=y
BR2_PACKAGE_LIBOPENSSL_ENGINES=y
BR2_PACKAGE_RHASH=y
BR2_PACKAGE_SQLITE_NO_SYNC=y
BR2_PACKAGE_LIBCONFIG=y
BR2_PACKAGE_LIBFUSE=y
BR2_PACKAGE_CAIRO_TEE=y
BR2_PACKAGE_LIBEXIF=y
BR2_PACKAGE_LIBHID=y
BR2_PACKAGE_LIBIIO=y
BR2_PACKAGE_LIBV4L=y
BR2_PACKAGE_LIBV4L_UTILS=y
BR2_PACKAGE_LIBXKBCOMMON=y
BR2_PACKAGE_MTDEV=y
BR2_PACKAGE_C_ARES=y
BR2_PACKAGE_LIBGSASL=y
BR2_PACKAGE_LIBHTTPPARSER=y
BR2_PACKAGE_LIBIDN=y
BR2_PACKAGE_LIBIDN_BINARY=y
BR2_PACKAGE_LIBMBUS=y
BR2_PACKAGE_LIBMICROHTTPD=y
BR2_PACKAGE_LIBMODBUS=y
BR2_PACKAGE_LIBNETFILTER_CONNTRACK=y
BR2_PACKAGE_LIBNETFILTER_CTHELPER=y
BR2_PACKAGE_LIBNETFILTER_CTTIMEOUT=y
BR2_PACKAGE_LIBNETFILTER_QUEUE=y
BR2_PACKAGE_LIBRSYNC=y
BR2_PACKAGE_LIBSRTP=y
BR2_PACKAGE_LIBVNCSERVER=y
BR2_PACKAGE_LIBVNCSERVER_TIGHTPNG=y
BR2_PACKAGE_LIBWEBSOCKETS=y
BR2_PACKAGE_NEON=y
BR2_PACKAGE_NEON_ZLIB=y
BR2_PACKAGE_NEON_SSL=y
BR2_PACKAGE_NEON_LIBXML2=y
BR2_PACKAGE_LIBPTHREAD_STUBS=y
BR2_PACKAGE_LIBTASN1=y
BR2_PACKAGE_LIBUV=y
BR2_PACKAGE_NCURSES_TARGET_PROGS=y
BR2_PACKAGE_PCRE2=y
BR2_PACKAGE_PCRE2_16=y
BR2_PACKAGE_ARPTABLES=y
BR2_PACKAGE_BIND=y
BR2_PACKAGE_BLUEZ_TOOLS=y
BR2_PACKAGE_BLUEZ5_UTILS=y
BR2_PACKAGE_BLUEZ5_UTILS_CLIENT=y
BR2_PACKAGE_BLUEZ5_UTILS_DEPRECATED=y
BR2_PACKAGE_BRIDGE_UTILS=y
BR2_PACKAGE_CRDA=y
BR2_PACKAGE_DHCPCD=y
BR2_PACKAGE_DNSMASQ=y
# BR2_PACKAGE_DNSMASQ_TFTP is not set
BR2_PACKAGE_GESFTPSERVER=y
BR2_PACKAGE_HOSTAPD=y
BR2_PACKAGE_HOSTAPD_EAP=y
BR2_PACKAGE_HOSTAPD_WPS=y
BR2_PACKAGE_IFTOP=y
BR2_PACKAGE_IFUPDOWN=y
BR2_PACKAGE_IPROUTE2=y
BR2_PACKAGE_IPTABLES=y
BR2_PACKAGE_IW=y
BR2_PACKAGE_MOSQUITTO=y
BR2_PACKAGE_NET_TOOLS=y
BR2_PACKAGE_NTP=y
BR2_PACKAGE_NTP_NTPDATE=y
BR2_PACKAGE_NTP_NTPDC=y
BR2_PACKAGE_NTP_NTPTIME=y
BR2_PACKAGE_OPENOBEX=y
BR2_PACKAGE_OPENSSH=y
BR2_PACKAGE_OPENVPN=y
BR2_PACKAGE_OPENVPN_SMALL=y
BR2_PACKAGE_PPTP_LINUX=y
BR2_PACKAGE_RSYNC=y
BR2_PACKAGE_WGET=y
BR2_PACKAGE_WIRELESS_TOOLS=y
BR2_PACKAGE_WIRELESS_TOOLS_LIB=y
BR2_PACKAGE_WPA_SUPPLICANT=y
BR2_PACKAGE_WPA_SUPPLICANT_AP_SUPPORT=y
BR2_PACKAGE_WPA_SUPPLICANT_WIFI_DISPLAY=y
BR2_PACKAGE_WPA_SUPPLICANT_AUTOSCAN=y
BR2_PACKAGE_WPA_SUPPLICANT_EAP=y
BR2_PACKAGE_WPA_SUPPLICANT_HOTSPOT=y
BR2_PACKAGE_WPA_SUPPLICANT_DEBUG_SYSLOG=y
BR2_PACKAGE_WPA_SUPPLICANT_WPS=y
BR2_PACKAGE_WPA_SUPPLICANT_CLI=y
BR2_PACKAGE_WPA_SUPPLICANT_WPA_CLIENT_SO=y
BR2_PACKAGE_WPA_SUPPLICANT_PASSPHRASE=y
BR2_PACKAGE_WPA_SUPPLICANT_DBUS=y
BR2_PACKAGE_WPA_SUPPLICANT_DBUS_INTROSPECTION=y
BR2_PACKAGE_DASH=y
BR2_PACKAGE_GNUPG=y
BR2_PACKAGE_GNUPG_RSA=y
BR2_PACKAGE_SCREEN=y
BR2_PACKAGE_SUDO=y
BR2_PACKAGE_ATTR=y
BR2_PACKAGE_HTOP=y
BR2_PACKAGE_KEYUTILS=y
BR2_PACKAGE_UTIL_LINUX_SETTERM=y
BR2_PACKAGE_JOE=y
# BR2_PACKAGE_JOE_FULL is not set
BR2_PACKAGE_LESS=y
BR2_PACKAGE_NANO=y
BR2_TARGET_ROOTFS_EXT2=y
BR2_TARGET_ROOTFS_EXT2_3=y
BR2_TARGET_ROOTFS_EXT2_SIZE="256M"
BR2_TARGET_ROOTFS_TAR_GZIP=y
BR2_TARGET_ROOTFS_UBI=y
BR2_TARGET_ROOTFS_UBIFS_OPTS="-F"
BR2_PACKAGE_HOST_DOSFSTOOLS=y
BR2_PACKAGE_HOST_DTC=y
BR2_PACKAGE_HOST_GENIMAGE=y
BR2_PACKAGE_HOST_MTOOLS=y
BR2_PACKAGE_LIBFREEFARE_GIT=y
BR2_PACKAGE_CIVETWEB_GIT=y
BR2_PACKAGE_PYTHON_FTROBOPY=y
BR2_PACKAGE_PYTHON_SPEEDTEST_CLI=y
```

## package/libnfc-git/Config.in
```kconfig
config BR2_PACKAGE_LIBNFC_GIT
	bool "libnfc-git"
	depends on BR2_TOOLCHAIN_HAS_THREADS # libusb
	select BR2_PACKAGE_LIBUSB
	select BR2_PACKAGE_LIBUSB_COMPAT
	help
	  Public platform independent Near Field Communication (NFC)
	  library.

	  http://www.libnfc.org/

if BR2_PACKAGE_LIBNFC_GIT

config BR2_PACKAGE_LIBNFC_GIT_EXAMPLES
	bool "build libnfc-git examples"
	select BR2_PACKAGE_READLINE

endif

comment "libnfc needs a toolchain w/ threads"
	depends on !BR2_TOOLCHAIN_HAS_THREADS
```

## package/libulfius/Config.in
```kconfig
config BR2_PACKAGE_LIBULFIUS
	bool "libulfius"
	select BR2_PACKAGE_LIBORCANIA
	select BR2_PACKAGE_LIBYDER
	help
		libulfius V 2.2.4
```

## package/libyder/Config.in
```kconfig
config BR2_PACKAGE_LIBYDER
	bool "libyder"
	select BR2_PACKAGE_LIBORCANIA
	help
		liborcania component.config V 1.1.1
```

## package/python-mod_wsgi/Config.in
```kconfig
config BR2_PACKAGE_PYTHON_MOD_WSGI
	bool "python-mod_wsgi"
	help
		The mod_wsgi package provides an Apache module that implements
		a WSGI compliant interface for hosting Python based
		web applications on top of the Apache web server.

		https://github.com/GrahamDumpleton/mod_wsgi
```

## package/python-speedtest-cli/Config.in
```kconfig
config BR2_PACKAGE_PYTHON_SPEEDTEST_CLI
	bool "python-speedtest-cli"
	select BR2_PACKAGE_PYTHON_SETUPTOOLS
	help
	  Command line interface for testing internet bandwidth using speedtest.net
```

## package/python-ufw/Config.in
```kconfig
config BR2_PACKAGE_PYTHON_UFW
	bool "python-ufw"
	help
	  UFW uncomplicated fore wall
```

## package/wt/Config.in
```kconfig
config BR2_PACKAGE_WT
	bool "wt"
	help
		Wt is a C++ library for developing web applications. It consists of:

		- libwt, a widget/rendering library
		- libwthttp, an (async I/O) HTTP/WebSockets server
		- libwtfcgi, a FastCGI connector library (Unix)
		- libwtisapi, an ISAPI connector library (Windows)
		- libwttest, a test connector environment

		It also contains a C++ ORM, which can be used in a web application
		(obviously), but can also be used on its own:

		- libwtdbo, a C++ ORM
		- libwtdbopostgres, PostgreSQL backend
		- libwtdbosqlite3, Sqlite3 backend
		- libwtdbofirebird, Firebird backend

		For more information, see [the homepage](http://www.webtoolkit.eu/wt
		"Wt homepage").
```
